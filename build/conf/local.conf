## build/conf/local.conf
```bitbake
# Where to store sources
DL_DIR = "${OETREE}/downloads"

# makes it hard to do any work if all staging stuff is removed 
# INHERIT += " rm_work "

# Make sure you have these installed
ASSUME_PROVIDED += "gdk-pixbuf-csource-native imagemagick-native librsvg-native"

# Which files do we want to parse:
BBFILES := "${OETREE}/openembedded/recipes/*/*.bb"
BBMASK = ""
 
# What kind of images do we want?
IMAGE_FSTYPES += " yaffs2 jffs2 ext2.gz tar.bz2 "

# Set TMPDIR instead of defaulting it to $pwd/tmp
# TMPDIR = "${OETREE}/${DISTRO}-dev"
TMPDIR = "/opt/oe"

# Make use of SMP and fast disks
PARALLEL_MAKE = "-j6"
BB_NUMBER_THREADS = "6"

#tinderbox
#INHERIT += "oestats-client"
OESTATS_BUILDER      = "dev"

#kc: see ~/oe/openembedded/contrib/testing/testbuilder or testbuilder.conf.sample for "angstrom-2010.x"
#./openembedded/conf/distro/angstrom-2010.x.conf
DISTRO = "angstrom-2010.x"
ENABLE_BINARY_LOCALE_GENERATION = "0"

# kc: for machine type, refer to 
# ~/oe/openembedded/conf/machine/*
# or ./openembedded/recipes/x-load/x-load_git.bb, ./openembedded/recipes/linux/linux-omap_2.6.31.bb
# COMPATIBLE_MACHINE = "omap5912osk|omap1710h3|omap2430sdp|omap2420h4|beagleboard|omap3evm|omap3-pandora|overo|omapzoom"
#./penembedded/conf/machine/omapzoom2.conf
#
# MACHINE = "torpedo" (or omap3_torpedo?)
# MACHINE = "beagleboard"
MACHINE = "alico"
```

## openembedded/conf/machine/alico.conf
```bitbake
#@TYPE: Machine
#@NAME: Alico machine
#@DESCRIPTION: Machine configuration for the http://alicosystems.com/ board 
TARGET_ARCH = "arm"

require conf/machine/include/omap3.inc

#PREFERRED_VERSION_u-boot = "git"
#PREFERRED_PROVIDER_u-boot = "u-boot-omap3"
#PREFERRED_PROVIDER_x-load = "x-load-omap3alico"
#PREFERRED_PROVIDER_virtual/bootloader = "u-boot"

#kc: we need to keep this here, otherwise nios2 errors
# also changed 
#PREFERRED_PROVIDER_virtual/kernel = "linux-omap-psp" 
#PREFERRED_PROVIDER_virtual/kernel = "${MACHINE}"
#PREFERRED_PROVIDER_virtual/kernel = "linux-omap-2.6.37"
#PREFERRED_PROVIDER_virtual/kernel = "linux-omap-${MACHINE}"
PREFERRED_PROVIDER_virtual/kernel = "linux-omap" 

IMAGE_FSTYPES += "jffs2 ext2.gz tar.bz2"
EXTRA_IMAGECMD_jffs2 = "-lnp "

# Guesswork
SERIAL_CONSOLE = "115200 tty02"

UBOOT_MACHINE = "omap3_alico_config"

# do ubiattach /dev/ubi_ctrl -m 4
# From dmesg:
# UBI: smallest flash I/O unit:    2048
# UBI: logical eraseblock size:    129024 bytes
# from ubiattach stdout:
# UBI device number 0, total 1996 LEBs
MKUBIFS_ARGS = "-m 2048 -e 129024 -c 1996"

# do ubiattach /dev/ubi_ctrl -m 4
# from dmesg:
# UBI: smallest flash I/O unit:    2048
# UBI: physical eraseblock size:   131072 bytes (128 KiB)
# UBI: sub-page size:              512
UBINIZE_ARGS = "-m 2048 -p 128KiB -s 512"

# and sdio
MACHINE_FEATURES = "kernel26 apm usbgadget usbhost vfat"
```
